## lib/utils/spm/Kconfig
```kconfig
# SPDX-License-Identifier: BSD-2-Clause

menu "Secure Partition Support"

config FDT_SPM
	bool "FDT based SPM ServiceGroups"
	depends on FDT
    select SPM
	default n

if FDT_SPM

config FDT_SPM_MM
	bool "StandaloneMm ServiceGroup"
	default n
endif

config SPM
	bool "SPM support"
	default n

endmenu
```
